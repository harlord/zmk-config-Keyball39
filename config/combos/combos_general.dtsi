//mira los valores de key-positions para actualizarlos acorde a estas reglas, si alguno de los valores es ygual a 20 o mayor de 20 se resta 1. Si alguno de los valores es igual a 32 o mayor de 32, se suma 1
// 20 o mas se resta 1
// 32 o mas se suma 1



        //     0  1  2  3  4             5  6  7  8  9
        //    10 11 12 13 14            15 16 17 18 19
        //    20 21 22 23 24            25 26 27 28 29 
        //    30 31 32 33 34 35      36 37          38

        //     0  1  2  3  4     5  6  7  8  9
        //    10 11 12 13 14    15 16 17 18 19
        //20  21 22 23 24 25    26 27 28 29 30  31
        //        32 33 34         35 36 37

#define REQUIRE_PRIOR_IDLE_MS 120   
#define COMBO(NAME, BINDINGS, KEYPOS) \
  combo_##NAME { \
    timeout-ms = <199>; \
    bindings = <BINDINGS>; \
    key-positions = <KEYPOS>; \
    slow-release; \
    layers = <BASE>; \
  };
#define LCOMBOACT(NAME, BINDINGS, KEYPOS) \
  LCOMBOACT_##NAME { \
    timeout-ms = <2000>; \
    bindings = <BINDINGS>; \
    key-positions = <KEYPOS>; \
    slow-release; \
    require-prior-idle-ms = <REQUIRE_PRIOR_IDLE_MS>; \
    layers = <BASE NAVOVERR DIRECTACC NUMBERS RAISE LOWER FUNC MOUSE SNIPE WARP SCROLL FAST MOUSETOP SCROLLTOP>; \
  };
#define RCOMBO(NAME, BINDINGS, KEYPOS) \
  rcombo_##NAME { \
    timeout-ms = <500>; \
    bindings = <BINDINGS>; \
    key-positions = <KEYPOS>; \
    require-prior-idle-ms = <REQUIRE_PRIOR_IDLE_MS>; \
    layers = <BASE DIRECTACC RAISE FUNC>; \
  };
#define RCOMBOMOUSE(NAME, BINDINGS, KEYPOS) \
  rcombomouse_##NAME { \
    timeout-ms = <800>; \
    bindings = <BINDINGS>; \
    require-prior-idle-ms = <REQUIRE_PRIOR_IDLE_MS>; \
    key-positions = <KEYPOS>; \
  };
#define RCOMBOMOUSEACTION(NAME, BINDINGS, KEYPOS) \
  rcombomouseoaction_##NAME { \
    timeout-ms = <1000>; \
    bindings = <&mo MOUSE>, <BINDINGS>; \
    key-positions = <KEYPOS>; \
    slow-release; \
    layers = <BASE DIRECTACC RAISE FUNC>; \
  };
#define LCOMBO(NAME, BINDINGS, KEYPOS) \
  lcombo_##NAME { \
    timeout-ms = <500>; \
    bindings = <BINDINGS>; \
    key-positions = <KEYPOS>; \
    require-prior-idle-ms = <REQUIRE_PRIOR_IDLE_MS>; \
    layers = <BASE DIRECTACC RAISE NUMBERS LOWER FUNC MOUSE SNIPE WARP SCROLL FAST MOUSETOP SCROLLTOP>; \
  };
#define NAVBACOMBO(NAME, BINDINGS, KEYPOS) \
  navcombo_##NAME { \
    timeout-ms = <70>; \
    bindings = <BINDINGS>; \
    key-positions = <KEYPOS>; \
    layers = <NAVOVERR>; \
  };
#define NAVBACOMBOINV(NAME, BINDINGS, KEYPOS) \
  navcomboinv_##NAME { \
    timeout-ms = <200>; \
    bindings = <BINDINGS>; \
    key-positions = <KEYPOS>; \
    layers = <BASE>; \
  };
#define COMBODIRECTACC(NAME, BINDINGS, KEYPOS) \
  comboda_##NAME { \
    timeout-ms = <500>; \
    bindings = <BINDINGS>; \
    key-positions = <KEYPOS>; \
    layers = <SYSTEM>; \
  };
#define COMBOADJ(NAME, BINDINGS, KEYPOS) \
  comboadj_##NAME { \
    timeout-ms = <500>; \
    bindings = <BINDINGS>; \
    key-positions = <KEYPOS>; \
    layers = <ADJ>; \
  };
#define COMBOTS(NAME, BINDINGS, KEYPOS) \
  combots_##NAME { \
    timeout-ms = <500>; \
    bindings = <BINDINGS>; \
    key-positions = <KEYPOS>; \
    layers = <TILDESHIFT>; \
  };


#define CBKS(BINDINGS, KEYPOS) \
  cbks_##KEYPOS { \
    timeout-ms = <2000>; \
    bindings = <BINDINGS>; \
    key-positions = <KEYPOS 34>; \
    key-positions-leader = <KEYPOS>; \
    key-positions-first-exclude = <34>; \
    layers = <BASE DIRECTACC RAISE FUNC>; \
  };
#define CBKSHIFT(BINDINGS, KEYPOS) \
  cbkshift_##KEYPOS { \
    timeout-ms = <2000>; \
    bindings = <&mshoff>, <BINDINGS>; \
    key-positions = <KEYPOS 34>; \
    key-positions-leader = <KEYPOS>; \
    key-positions-first-exclude = <34>; \
    slow-release; \
    layers = <BASE DIRECTACC RAISE FUNC>; \
  };
#define CBKDALEFT(BINDINGS, KEYPOS) \
  cbkdaleft_##KEYPOS { \
    timeout-ms = <2000>; \
    bindings = <&mo DIRECTACC>, <BINDINGS>; \
    key-positions = <KEYPOS 34>; \
    key-positions-leader = <KEYPOS>; \
    key-positions-first-exclude = <34>; \
    slow-release; \
    layers = <BASE MOUSE DIRECTACC RAISE FUNC>; \
  };
#define CBKLLEFT(BINDINGS, KEYPOS) \
  cbklleft_##KEYPOS { \
    timeout-ms = <2000>; \
    bindings = <BINDINGS>; \
    key-positions = <KEYPOS 34>; \
    key-positions-leader = <KEYPOS>; \
    key-positions-first-exclude = <34>; \
    slow-release; \
    layers = <BASE MOUSE DIRECTACC RAISE FUNC>; \
  };
#define CTKSPA(BINDINGS, KEYPOS) \
  ctkspa_##KEYPOS { \
    timeout-ms = <2000>; \
    bindings = <&mo DIRECTACC>, <BINDINGS>; \
    key-positions = <KEYPOS 34>; \
    key-positions-first-exclude = <34>; \
    key-positions-leader = <KEYPOS>; \
    slow-release; \
    layers = <BASE DIRECTACC RAISE FUNC>; \
  };
#define CTKSLW(BINDINGS, KEYPOS) \
  ctkspa_##KEYPOS { \
    timeout-ms = <2000>; \
    bindings = <&mo LOWER>, <BINDINGS>; \
    key-positions = <KEYPOS 34>; \
    key-positions-first-exclude = <34>; \
    key-positions-leader = <KEYPOS>; \
    slow-release; \
    layers = <BASE DIRECTACC RAISE FUNC>; \
  };

#define CTAB(BINDINGS, KEYPOS) \
  ctab_##KEYPOS { \
    timeout-ms = <2000>; \
    bindings = <&mo LOWER>, <BINDINGS>; \
    key-positions = <KEYPOS 35>; \
    key-positions-first-exclude = <35>; \
    key-positions-leader = <KEYPOS>; \
    slow-release; \
    layers = <BASE DIRECTACC RAISE FUNC>; \
  };
#define CTABD(BINDINGS, KEYPOS) \
  ctabd_##KEYPOS { \
    timeout-ms = <2000>; \
    bindings = <BINDINGS>; \
    key-positions = <KEYPOS 35>; \
    key-positions-first-exclude = <35>; \
    key-positions-leader = <KEYPOS>; \
    slow-release; \
    layers = <BASE DIRECTACC RAISE FUNC>; \
  };
#define CTABDLEFT(BINDINGS, KEYPOS) \
  ctabdleft_##KEYPOS { \
    timeout-ms = <2000>; \
    bindings = <BINDINGS>; \
    key-positions = <KEYPOS 35>; \
    key-positions-first-exclude = <35>; \
    key-positions-leader = <KEYPOS>; \
    slow-release; \
    layers = <BASE DIRECTACC NUMBERS RAISE FUNC MOUSE SNIPE WARP SCROLL FAST MOUSETOP SCROLLTOP>; \
  };
#define CTABS(BINDINGS, KEYPOS) \
  ctabs_##KEYPOS { \
    timeout-ms = <2000>; \
    bindings = <BINDINGS>; \
    key-positions = <KEYPOS 35>; \
    key-positions-first-exclude = <35>; \
    key-positions-leader = <KEYPOS>; \
    layers = <BASE DIRECTACC RAISE FUNC>; \
  };
#define CTABDA(BINDINGS, KEYPOS) \
  ctabda_##KEYPOS { \
    timeout-ms = <2000>; \
    bindings = <&mo DIRECTACC>, <BINDINGS>; \
    key-positions = <KEYPOS 35>; \
    key-positions-first-exclude = <35>; \
    key-positions-leader = <KEYPOS>; \
    slow-release; \
    layers = <BASE DIRECTACC RAISE FUNC>; \
  };
#define CENT(BINDINGS, KEYPOS) \
  cent_##KEYPOS { \
    timeout-ms = <2000>; \
    bindings = <&mo SYSTEM>, <BINDINGS>; \
    key-positions = <KEYPOS 36>; \
    key-positions-first-exclude = <36>; \
    key-positions-leader = <KEYPOS>; \
    slow-release; \
    layers = <BASE DIRECTACC NUMBERS RAISE FUNC>; \
  };


#define CENTD(BINDINGS, KEYPOS) \
  centd_##KEYPOS { \
    timeout-ms = <2000>; \
    bindings = <BINDINGS>; \
    key-positions = <KEYPOS 36>; \
    key-positions-first-exclude = <36>; \
    key-positions-leader = <KEYPOS>; \
    slow-release; \
    layers = <BASE DIRECTACC RAISE FUNC>; \
  };
#define CENTDLEFT(BINDINGS, KEYPOS) \
  centddleft_##KEYPOS { \
    timeout-ms = <2000>; \
    bindings = <&mo SYSTEM>, <BINDINGS>; \
    key-positions = <KEYPOS 36>; \
    key-positions-first-exclude = <36>; \
    key-positions-leader = <KEYPOS>; \
    slow-release; \
    layers = <BASE DIRECTACC RAISE NUMBERS FUNC MOUSE SNIPE WARP SCROLL FAST MOUSETOP SCROLLTOP>; \
  };


#define CSPC(BINDINGS, KEYPOS) \
  cspc_##KEYPOS { \
    timeout-ms = <2000>; \
    bindings = <&mo NUMBERS>, <BINDINGS>; \
    key-positions = <KEYPOS 37>; \
    key-positions-first-exclude = <37>; \
    key-positions-leader = <KEYPOS>; \
    slow-release; \
    require-prior-idle-ms = <1000>; \
    layers = <BASE DIRECTACC RAISE FUNC>; \
  };
#define CSPCS(BINDINGS, KEYPOS) \
  cspcs_##KEYPOS { \
    timeout-ms = <2000>; \
    bindings = <&mo NUMBERS>, <BINDINGS>; \
    key-positions = <KEYPOS 37>; \
    key-positions-first-exclude = <37>; \
    key-positions-leader = <KEYPOS>; \
    layers = <BASE DIRECTACC RAISE FUNC>; \
  };

    combos {
        compatible = "zmk,combos";
        //LEFT HAND

        LCOMBOACT(comb_qwf, &kp ESC, 0 1 2)
        LCOMBOACT(comb_wfp, &kp SPACE, 1 2 3)
        LCOMBOACT(comb_pb, &kp ENTER, 3 4)
        LCOMBOACT(comb_tg, &kp TAB, 13 14)
        LCOMBOACT(comb_rst, &kp BACKSPACE, 11 12 13)
        LCOMBOACT(comb_ars, &kp DELETE, 10 11 12)
        LCOMBO(comb_gv, &kp MINUS, 14 24)// G V
        LCOMBO(comb_td, &kp GRAVE, 13 23)// T D 
        LCOMBO(comb_sc, &kp RBKT, 12 22)// S C
        LCOMBO(comb_rx, &kp LBKT, 11 21)// R X
        LCOMBO(comb_az, &kp BSLH, 10 20)// A Z
        //RIGHT HAND

        RCOMBOMOUSE(requal, &kp EQUAL, 15 25)
        RCOMBO(rsemi, &kp SEMI, 16 26)
        RCOMBO(SEMI, &kp COMMA, 17 27)
        RCOMBO(COLON, &kp DOT, 18 28)
        RCOMBO(FSLH, &kp FSLH, 19 29)

        //NUMBERS

        LCOMBO(NUM1, &kp N1, 0 10)
        LCOMBO(NUM2, &kp N2, 1 11)
        LCOMBO(NUM3, &kp N3, 2 12)
        LCOMBO(NUM4, &kp N4, 3 13)
        LCOMBO(NUM5, &kp N5, 4 14)
        RCOMBO(NUM6, &kp N6, 5 15)
        RCOMBO(NUM7, &kp N7, 6 16)
        RCOMBO(NUM8, &kp N8, 7 17) 
        RCOMBO(NUM9, &kp N9, 8 18)
        RCOMBO(NUM0, &kp N0, 9 19)

        //NavOverR

        //NAVBACOMBO(pg_0, &kp HOME, 26 27)// H , 
        //NAVBACOMBO(pg_1, &kp END, 27 28)// , .
        //NAVBACOMBO(pg_4, &kp PG_UP, 26 17)// , H 
        //NAVBACOMBO(pg_5, &kp PG_DN, 17 28)// H .

        //MOUSE

        //NAVBACOMBOINV(pg_0_inv, &kp HOME, 22 23 33)//  
        //NAVBACOMBOINV(pg_1_inv, &kp END, 23 24 33)// 
        //NAVBACOMBOINV(pg_4_inv, &kp PG_UP, 22 12 33)//  
        //NAVBACOMBOINV(pg_5_inv, &kp PG_DN, 12 24 33)// 
        // ADJUST

        COMBODIRECTACC(adj_tog_on, &tog_on ADJ,  0  1  2  3 )
        COMBOADJ(adj_tog_off, &tog_off ADJ,  0  1  2  3 )

        RCOMBOMOUSEACTION(l_click, &mcmou LCLK, 16 17 18)
        RCOMBOMOUSEACTION(r_click, &mcmou RCLK, 17 18 19)

        combo_scroll_up: combo_scroll_up {
            bindings = <&mo SCROLLTOP>;   // or your desired behavior
            key-positions = <17>;     // the key you press
            timeout-ms = <1000>;       // regular combo timeout
            require-pointer-move;     // gate on movement
            pointer-move-timeout-ms = <500>; // optional; else uses timeout-ms
            layers = <BASE>;          // where it applies
        };

        combo_snipe_up: combo_snipe_up {
            bindings = <&mo SNIPE>;   // or your desired behavior
            key-positions = <18>;     // the key you press
            timeout-ms = <1000>;       // regular combo timeout
            require-pointer-move;     // gate on movement
            pointer-move-timeout-ms = <500>; // optional; else uses timeout-ms
            layers = <BASE>;          // where it applies
        };

        //////////////////////
        //START Dragmod LEFT//
        //////////////////////

        c-hr-thumb-arl {
            bindings = <&kp LS(LCTRL)>;
            key-positions = <35 20 21>;
            layers = <BASE MOUSE SNIPE WARP SCROLL>;
            slow-release;
            key-positions-first-exclude = <35>;
            timeout-ms = <2000>;
        };

        c-hr-thumb-arsl {
            bindings = <&kp LS(LA(LCTRL))>;
            key-positions = <35 20 21 22>;
            layers = <BASE MOUSE SNIPE WARP SCROLL>;
            slow-release;
            key-positions-first-exclude = <35>;
            timeout-ms = <2000>;
        };

        c-hr-thumb-arstl {
            bindings = <&kp LS(LA(LG(LCTRL)))>;
            key-positions = <35 20 21 22 23>;
            layers = <BASE MOUSE SNIPE WARP SCROLL>;
            slow-release;
            key-positions-first-exclude = <35>;
            timeout-ms = <2000>;
        };

        c-hr-thumb-artl {
            bindings = <&kp LS(LC(LCMD))>;
            key-positions = <35 20 21 23>;
            layers = <BASE MOUSE SNIPE WARP SCROLL>;
            slow-release;
            key-positions-first-exclude = <35>;
            timeout-ms = <2000>;
        };

        c-hr-thumb-astl {
            bindings = <&kp LS(LA(LCMD))>;
            key-positions = <35 20 23 22>;
            layers = <BASE MOUSE SNIPE WARP SCROLL>;
            slow-release;
            key-positions-first-exclude = <35>;
            timeout-ms = <2000>;
        };

        c-hr-thumb-rstl {
            bindings = <&kp LA(LC(LCMD))>;
            key-positions = <35 23 22 21>;
            layers = <BASE MOUSE SNIPE WARP SCROLL>;
            slow-release;
            key-positions-first-exclude = <35>;
            timeout-ms = <2000>;
        };

        c-hr-thumb-atl {
            bindings = <&kp LS(LCMD)>;
            key-positions = <35 23 20>;
            layers = <BASE MOUSE SNIPE WARP SCROLL>;
            slow-release;
            key-positions-first-exclude = <35>;
            timeout-ms = <2000>;
        };

        c-hr-thumb-stl {
            bindings = <&kp LA(LCMD)>;
            key-positions = <35 22 23>;
            layers = <BASE MOUSE SNIPE WARP SCROLL>;
            slow-release;
            key-positions-first-exclude = <35>;
            timeout-ms = <2000>;
        };

        c-hr-thumb-rsl {
            bindings = <&kp LC(LALT)>;
            key-positions = <35 22 21>;
            layers = <BASE MOUSE SNIPE WARP SCROLL>;
            slow-release;
            key-positions-first-exclude = <35>;
            timeout-ms = <2000>;
        };

        c-hr-thumb-rtl {
            bindings = <&kp LC(LCMD)>;
            key-positions = <35 23 21>;
            layers = <BASE MOUSE SNIPE WARP SCROLL>;
            slow-release;
            key-positions-first-exclude = <35>;
            timeout-ms = <2000>;
        };

        c-hr-thumb-asl {
            bindings = <&kp LS(LALT)>;
            key-positions = <35 20 22>;
            layers = <BASE MOUSE SNIPE WARP SCROLL>;
            slow-release;
            key-positions-first-exclude = <35>; 
            timeout-ms = <2000>;
        };

        ///////////////////////
        //START Dragmod RIGHT//
        ///////////////////////

       c-hr-thumb-arr {
            bindings = <&kp LS(LCTRL)>;
            key-positions = <35 29 28>;
            layers = <BASE>;
            slow-release;
            key-positions-first-exclude = <35>;
            timeout-ms = <2000>;
        };

        c-hr-thumb-arsr {
            bindings = <&kp LS(LA(LCTRL))>;
            key-positions = <35 29 28 27>;
            layers = <BASE>;
            slow-release;
            key-positions-first-exclude = <35>;
            timeout-ms = <2000>;
        };

        c-hr-thumb-arstr {
            bindings = <&kp LS(LA(LG(LCTRL)))>;
            key-positions = <35 29 28 27 26>;
            layers = <BASE>;
            slow-release;
            key-positions-first-exclude = <35>;
            timeout-ms = <2000>;
        };

        c-hr-thumb-artr {
            bindings = <&kp LS(LC(LCMD))>;
            key-positions = <35 29 28 26>;
            layers = <BASE>;
            slow-release;
            key-positions-first-exclude = <35>;
            timeout-ms = <2000>;
        };

        c-hr-thumb-astr {
            bindings = <&kp LS(LA(LCMD))>;
            key-positions = <35 29 26 27>;
            layers = <BASE>;
            slow-release;
            key-positions-first-exclude = <35>;
            timeout-ms = <2000>;
        };

        c-hr-thumb-rstr {
            bindings = <&kp LA(LC(LCMD))>;
            key-positions = <35 26 27 28>;
            layers = <BASE>;
            slow-release;
            key-positions-first-exclude = <35>;
            timeout-ms = <2000>;
        };

        c-hr-thumb-atr {
            bindings = <&kp LS(LCMD)>;
            key-positions = <35 26 29>;
            layers = <BASE>;
            slow-release;
            key-positions-first-exclude = <35>;
            timeout-ms = <2000>;
        };

        c-hr-thumb-str {
            bindings = <&kp LA(LCMD)>;
            key-positions = <35 27 26>;
            layers = <BASE>;
            slow-release;
            key-positions-first-exclude = <35>;
            timeout-ms = <2000>;
        };

        c-hr-thumb-rsr {
            bindings = <&kp LC(LALT)>;
            key-positions = <35 27 28>;
            layers = <BASE>;
            slow-release;
            key-positions-first-exclude = <35>;
            timeout-ms = <2000>;
        };

        c-hr-thumb-rtr {
            bindings = <&kp LC(LCMD)>;
            key-positions = <35 26 28>;
            layers = <BASE>;
            slow-release;
            key-positions-first-exclude = <35>;
            timeout-ms = <2000>;
        };

        c-hr-thumb-asr {
            bindings = <&kp LS(LALT)>;
            key-positions = <35 29 27>;
            layers = <BASE>;
            slow-release;
            key-positions-first-exclude = <35>; 
            timeout-ms = <2000>;
        };

        ///////////////
        //END Dragmod//
        ///////////////

//shift+BKSPACE<>TILDE 
CBKSHIFT(&mshon LA(N1), 0)                CBKLLEFT(&mo DIRECTACC, 1)                    CBKLLEFT(&mo FUNC, 2)                        CBKLLEFT(&mo NUMBERS, 3)          CBKLLEFT(&mo SYSTEM, 4)                                                                 CBKS(&mc_bkctilde U, 7) 
CBKS(&mc_bkctilde A, 10)                  CBKDALEFT(&td_find_g_ht LG(F) LG(LS(F)), 11)  CBKDALEFT(&lrlMo LA(LS(H)) LA(LS(F12)), 12)  CBKDALEFT(&kp LC(LS(MINUS)), 13)  CBKDALEFT(&kp LC(MINUS), 14)              CBKS(&caps_word, 15)  CBKS(&mc_ennesd N, 16)  CBKS(&mc_bkctilde E, 17)  CBKS(&mc_bkctilde I, 18)  CBKS(&mc_bkctilde O, 19)
/*CBKDALEFT(&td_find_s_ht A LG(F), 20)*/                                                                                                                               CBKS(&caps_word, 24)                                                                                                                        //CBKSHIFT(&mshon LS(LA(SLASH)), 29)       
//commented to avoid ALT conflict

//cmd+TAB<>DRAGTHUMB(inverted LOWER and DIRECTACC in low row only when DRAGTHUMB not activated)    
CTABDLEFT(&kp LSHFT, 20)          CTABDLEFT(&kp LCTRL, 21)                CTABDLEFT(&kp LALT, 22)                   CTABDLEFT(&kp LGUI, 23)       CTABDLEFT(&kp CAPS, 24)                 CTABD(&kp CAPS, 25)  CTABD(&kp LGUI, 26)  CTABD(&kp LALT, 27)  CTABD(&kp LCTRL, 28)  CTABD(&kp LSHFT, 29)

//CTAB(&kp N1, 0)                    CTAB(&kp N2, 1)                        CTAB(&kp N3, 2)                            CTAB(&kp N4, 3)                CTAB(&kp N5, 4)                         CTAB(&kp N6, 5)      CTAB(&kp N7, 6)       CTAB(&kp N8, 7)       CTAB(&kp N9, 8)        CTAB(&kp N0, 9)
//CTABDLEFT(&kp LSHFT, 10)          CTABDLEFT(&kp LCTRL, 11)              CTABDLEFT(&kp LALT, 12)                   CTABDLEFT(&kp LGUI, 13)       CTABDLEFT(&kp CAPS, 14)                 CTABD(&kp CAPS, 15)  CTABD(&kp LGUI, 16)  CTABD(&kp LALT, 17)  CTABD(&kp LCTRL, 18)  CTABD(&kp LSHFT, 19)
//CTABDA(&td_find_s_ht A LG(F), 20)  CTABDA(&td_find_g_ht A LG(LS(F)), 21)  CTABDA(&lrlMo LA(LS(H)) LA(LS(F12)), 22)   CTABDA(&kp LC(LS(MINUS)), 23)  CTABDA(&kp LC(MINUS), 24)        

//ENT+RAISE

CENTDLEFT(&kp LC(C_BRI_DN), 0)          CENTDLEFT(&kp LC(C_BRI_UP), 1)                CENTDLEFT(&kp C_BRI_DN, 2)                      CENTDLEFT(&kp C_BRI_UP, 3)                                                 CENTDLEFT(&kp C_VOL_UP, 5)    CENT(&kp C_PREV, 6)   CENT(&kp C_PP, 7)     CENT(&kp C_NEXT, 8)     
                                        CENTDLEFT(&kp LC(UP), 11)                     CENTDLEFT(&kp LC(DOWN), 12)                     CENTDLEFT(&kp F11, 13)              CENTDLEFT(&kp LC(LS(LEFT)), 14)        CENTDLEFT(&kp C_VOL_DN, 15)   CENT(&bt_0, 16)       CENT(&bt_1, 17)       CENT(&bt_2, 18)          CENT(&bt_3, 19)
                                                                                                                                                                                                                 CENTDLEFT(&kp C_MUTE, 25)
//CENTDLEFT(&kp LSHFT, 10)          CENTDLEFT(&kp LCTRL, 11)                CENTDLEFT(&kp LALT, 12)                   CENTDLEFT(&kp LGUI, 13)       CENTDLEFT(&kp CAPS, 14)           CENT(&kp C_VOL_DN, 15)   CENTD(&kp LGUI, 16)  CENTD(&kp LALT, 17)  CENTD(&kp LCTRL, 18)  CENTD(&kp LSHFT, 19)
//CENT(LA(Q), 0)    CENT(LA(W), 1)    CENT(LA(F), 2)    CENT(LA(P), 3)    CENT(LA(B), 4)                  CENT(LA(J), 5)   CENT(LA(L), 6)   CENT(LA(U), 7)       CENT(LA(Y), 8)     CENT(LA(SQT), 9)
//CENT(LA(A), 10)   CENT(LA(R), 11)   CENT(LA(S), 12)   CENT(LA(T), 13)   CENT(LA(G), 14)                 CENT(LA(M), 15)  CENT(LA(N), 16)  CENT(LA(E), 17)      CENT(LA(I), 18)    CENT(LA(O), 19)
//CENT(LA(Z), 20)   CENT(LA(X), 21)   CENT(LA(C), 22)   CENT(LA(D), 23)   CENT(LA(V), 24)                 CENT(LA(K), 25)  CENT(LA(H), 26)  CENT(LA(COMMA), 27)  CENT(LA(DOT), 28)  CENT(LA(SLASH), 29)


//CENT(&kp EXCL, 0)  CENT(&kp AT, 1)    CENT(&kp HASH, 2)  CENT(&kp DLLR, 3)   CENT(&kp PRCNT, 4)          CENT(&kp CARET, 5)   CENT(&kp AMPS, 6)    CENT(&kp STAR, 7)    CENT(&kp LPAR, 8)  CENT(&kp RPAR, 9)
//CENT(&kp PIPE, 10) CENT(&kp LBRC, 11) CENT(&kp RBRC, 12) CENT(&kp TILDE, 13) CENT(&kp UNDER, 14)         CENT(&kp PLUS, 15)   CENT(&kp COLON, 16)  CENT(&kp LT, 17)     CENT(&kp GT, 18)   CENT(&kp QUESTION, 19)
//CENT(&kp BSLH, 20) CENT(&kp LBKT, 21) CENT(&kp RBKT, 22) CENT(&kp GRAVE, 23) CENT(&kp MINUS, 24)         CENT(&kp EQUAL, 25)  CENT(&kp SEMI, 26)   CENT(&kp COMMA, 27)  CENT(&kp DOT, 28)  CENT(&kp SLASH, 29)

//NAVOVERR+SPC<>NUMBERS
//CSPC(&kp EXCL, 0)   CSPC(&kp AT, 1)     CSPC(&kp HASH, 2)  CSPC(&kp DLLR, 3)   CSPC(&kp PRCNT, 4)         CSPC(&kp EQUAL, 5)  CSPC(&kp N7, 6)    CSPC(&kp N6, 7)   CSPC(&kp N8, 8)   CSPC(&kp STAR, 9)
//CSPC(&kp LSHFT, 10) CSPC(&kp LCTRL, 11) CSPC(&kp LALT, 12) CSPC(&kp LGUI, 13)  CSPC(&kp COMMA, 14)        CSPC(&kp DOT, 15)   CSPC(&kp N4, 16)   CSPC(&kp N5, 17)  CSPC(&kp N6, 18)  CSPC(&kp N0, 19)
//CSPC(&kp BSLH, 21) // CSPC(&kp LBKT, 22)  CSPC(&kp RBKT, 23) CSPC(&kp GRAVE, 24) CSPC(&kp MINUS, 25)      CSPC(&kp PLUS, 26)  CSPC(&kp N1, 27)   CSPC(&kp N2, 28)  CSPC(&kp N3, 29)  CSPC(&kp SLASH, 30)

//CSPCS(&kp Q, 0)   CSPCS(&kp W, 1)     CSPCS(&kp F, 2)  CSPCS(&kp P, 3)   CSPCS(&kp B, 4)         CSPCS(&kp J, 5)  CSPCS(&kp L, 6)    CSPCS(&kp U, 7)   CSPCS(&kp Y, 8)   CSPCS(&kp SQT, 9)
//CSPCS(&kp A, 10) CSPCS(&kp R, 11) CSPCS(&kp S, 12) CSPCS(&kp T, 13)  CSPCS(&kp G, 14)        CSPCS(&kp M, 15)   CSPCS(&kp N, 16)   CSPCS(&kp E, 17)  CSPCS(&kp I, 18)  CSPCS(&kp O, 19)
//CSPCS(&kp Z, 21) // CSPCS(&kp C, 22)  CSPCS(&kp C, 23) CSPCS(&kp D, 24) CSPCS(&kp V, 25)      CSPCS(&kp K, 26)  CSPCS(&kp H, 27)   CSPCS(&kp COMMA, 28)  CSPCS(&kp DOT, 29)  CSPCS(&kp SLASH, 30)
    };