// Settings tuned for 3840 x 2160 display resolution
// Undefine first to avoid redefinition warnings (these are defined in pointing.h)
#ifdef ZMK_POINTING_DEFAULT_MOVE_VAL
#undef ZMK_POINTING_DEFAULT_MOVE_VAL
#endif
#ifdef ZMK_POINTING_DEFAULT_SCRL_VAL
#undef ZMK_POINTING_DEFAULT_SCRL_VAL
#endif

#define ZMK_POINTING_DEFAULT_MOVE_VAL 900 // 600
#define ZMK_POINTING_DEFAULT_SCRL_VAL 5  // 10

#include <dt-bindings/zmk/pointing.h>
#include <input/processors.dtsi>
#include <zephyr/dt-bindings/input/input-event-codes.h>

// Keyboard mouse emulation behaviors (not used - trackball handles pointing)
// Keep this file for pointing.h include and default values
