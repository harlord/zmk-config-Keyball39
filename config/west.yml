## config/west.yml
```yaml
manifest:
  remotes:
    - name: harlord
      url-base: https://github.com/harlord      
  projects:
    - name: zmk
      remote: harlord
      revision: main-local2-to-zephyr-4-1
      import: app/west.yml
  self:
    path: config
```
