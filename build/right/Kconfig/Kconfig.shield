## build/right/Kconfig/Kconfig.shield
```kconfig
osource "/Users/haroldhernandez/keyball39/zmk-config-Keyball39/zmk/app/boards/shields/*/Kconfig.shield"
osource "/Users/haroldhernandez/keyball39/zmk-config-Keyball39/config/boards/shields/*/Kconfig.shield"
```

## build/right/Kconfig/Kconfig.shield.defconfig
```kconfig
osource "/Users/haroldhernandez/keyball39/zmk-config-Keyball39/zmk/app/boards/shields/*/Kconfig.defconfig"
osource "/Users/haroldhernandez/keyball39/zmk-config-Keyball39/config/boards/shields/*/Kconfig.defconfig"
```
